## chipone/mtk6739/V1.2.2/CHIPONE_add_timer/Kconfig
```kconfig
config TOUCHSCREEN_MTK_CHIPONE
    bool "CHIPON for Mediatek"
    depends on I2C
    default n
    help
      Say Y here if you have CHIPON touch panel.
      If unsure, say N.
```

## chipone/qcom8909_icn85xx/Kconfig
```kconfig
#
# Chipone ICN85XX Touchscreen driver
#
config TOUCHSCREEN_ICN85XX_GESTURE
	tristate "icn85xx touchpanel for gesture"
	depends on TOUCHSCREEN_ICN85XX_TS
	default n
	help
	  This is an interface support for Icn85xx touchscreens gesture.

	  Say Y here if you want to have an interface for Icn85xx touchscreen gesture
	  to your system.

	  If unsure, say N.

config TOUCHSCREEN_ICN85XX_FH
       bool "ICN85XX Touchscreens FH support."
       depends on TOUCHSCREEN_USB_CHECK
       help
         Say Y here if you need a icn85xx touchscreen FH function.
	 else say N
```

## focaltech/mtk6739_ft6x06/Kconfig
```kconfig
#
# Touchscreen driver configuration
#
config ft6x06_FIRMWARE
	string "ft6x06 for Mediatek firmware"

config TPD_ROTATE_90
	bool "ft6x06 for Mediatek package"
	default n
	help
	Say Y here if you have ft6x06 touch panel TPD_ROTATE_90.

	If unsure, say N.

	To compile this dirver as a module, choose M here: the
	module will be called.

config TPD_ROTATE_180
	bool "ft6x06 for Mediatek package"
	default n
	help
	Say Y here if you have ft6x06 touch panel TPD_ROTATE_180.

	If unsure, say N.

	To compile this dirver as a module, choose M here: the
	module will be called.

config TPD_ROTATE_270
	bool "ft6x06 for Mediatek package"
	default n
	help
	Say Y here if you have ft6x06 touch panel TPD_ROTATE_270.

	If unsure, say N.

	To compile this dirver as a module, choose M here: the
	module will be called.

config FT_AUTO_UPGRADE_SUPPORT
	bool "ft6x06 for Mediatek package"
	default y
	help
	Say Y here if you have ft6x06 touch panel FT_AUTO_UPGRADE_SUPPORT.

	If unsure, say N.

	To compile this dirver as a module, choose M here: the
	module will be called.

config CUST_FTS_APK_DEBUG
	bool "ft6x06 for Mediatek package"
	default y
	help
	Say Y here if you have ft6x06 touch panel CUST_FTS_APK_DEBUG.

	If unsure, say N.

	To compile this dirver as a module, choose M here: the
	module will be called.

config TPD_HAVE_CALIBRATION
	bool "ft6x06 for Mediatek package"
	default n
	help
	Say Y here if you have ft6x06 touch panel TPD_HAVE_CALIBRATION.

	If unsure, say N.

	To compile this dirver as a module, choose M here: the
	module will be called.

config TPD_CUSTOM_CALIBRATION
	bool "ft6x06 for Mediatek package"
	default n
	help
	Say Y here if you have ft6x06 touch panel TPD_CUSTOM_CALIBRATION.

	If unsure, say N.

	To compile this dirver as a module, choose M here: the
	module will be called.

config HCT_TP_GESTRUE
	bool "HCT_TP_GESTRUE"
	default n
	
config TPD_PROXIMITY
	bool "ft6x06 for Mediatek package"
	default n
	help
	Say Y here if you have ft6x06 touch panel TPD_CUSTOM_CALIBRATION.

	If unsure, say N.

	To compile this dirver as a module, choose M here: the
	module will be called.
```

## focaltech/sdm8909_ft3407/Kconfig
```kconfig
#**********uniscope-driver-modify-file-on-qualcomm-platform*****************#
#
# TOUCHSCREEN_FTS
#

config TOUCHSCREEN_FTS
	tristate "Focaltech Fts touchpanel driver"
	depends on TOUCHSCREEN_FOCALTECH
	default n
	help
	  This is the main file for touchpanel driver for TOUCHSCREEN_FTS

	  Say Y here if you have a TOUCHSCREEN_FTS touchscreen connected
	  to your system.

	  If unsure, say N.

	  To compile this driver as a module, choose M here: the
	  module will be called.


config TOUCHSCREEN_FOCALTECH_CORE
	tristate "Focaltech Fts touchpanel driver"
	depends on TOUCHSCREEN_FOCALTECH
	default n
	help
	  This is the main file for touchpanel driver for TOUCHSCREEN_FTS

	  Say Y here if you have a TOUCHSCREEN_FTS touchscreen connected
	  to your system.

	  If unsure, say N.

	  To compile this driver as a module, choose M here: the
	  module will be called.

config TOUCHSCREEN_CTL
	tristate "Focaltech Fts touchpanel driver"
	depends on TOUCHSCREEN_FOCALTECH
	default n
	help
	  This is the main file for touchpanel driver for TOUCHSCREEN_FTS

	  Say Y here if you have a TOUCHSCREEN_FTS touchscreen connected
	  to your system.

	  If unsure, say N.

	  To compile this driver as a module, choose M here: the
	  module will be called.

config TOUCHSCREEN_EX_FUN
	tristate "Focaltech Fts touchpanel driver"
	depends on TOUCHSCREEN_FOCALTECH
	default n
	help
	  This is the main file for touchpanel driver for TOUCHSCREEN_FTS

	  Say Y here if you have a TOUCHSCREEN_FTS touchscreen connected
	  to your system.

	  If unsure, say N.

	  To compile this driver as a module, choose M here: the
	  module will be called.

config TOUCHSCREEN_FLASH
	tristate "Focaltech Fts touchpanel driver"
	depends on TOUCHSCREEN_FOCALTECH
	default n
	help
	  This is the main file for touchpanel driver for TOUCHSCREEN_FTS

	  Say Y here if you have a TOUCHSCREEN_FTS touchscreen connected
	  to your system.

	  If unsure, say N.

	  To compile this driver as a module, choose M here: the
	  module will be called.

config TOUCHSCREEN_GESTURE
	tristate "Focaltech Fts touchpanel driver"
	depends on TOUCHSCREEN_FOCALTECH
	default n
	help
	  This is the main file for touchpanel driver for TOUCHSCREEN_FTS

	  Say Y here if you have a TOUCHSCREEN_FTS touchscreen connected
	  to your system.

	  If unsure, say N.

	  To compile this driver as a module, choose M here: the
	  module will be called.
```

## himax/mtk6797_hx83103/Kconfig
```kconfig
#
# Touchscreen driver configuration
#

config TOUCHSCREEN_HIMAX_CHIPSET
	bool "Himax touchpanel CHIPSET"
	depends on I2C
	help
	  Say Y here if you have a Himax CHIPSET touchscreen.
	  HIMAX controllers are multi touch controllers which can
	  report 10 touches at a time

          If unsure, say N.
          
```

## ilitek/mtk6739_ili9881x/Kconfig
```kconfig
#
# Touchscreen driver configuration
#


config ILI9881X_CONFIG_NEW
	string "ili9881x for Mediatek config"
```

## ilitek/mtk6739_ili_msg/Kconfig
```kconfig
#
# Touchscreen driver configuration
#
if TOUCHSCREEN_MTK_MSGDRV_V7_BIRD

config  BIRD_MSGDRV_V7_CTP_TSFW
	string "BIRD_MSGDRV_V7_CTP_TSFW Config"
	---help---
	  This selects the MSGDRV_V7_BIRD driver.

endif
```

## novatek/mtk6739_nt36xxx/Kconfig
```kconfig
#
# Touchscreen driver configuration
#
if TOUCHSCREEN_MTK_NT36525

config TOUCHSCREEN_NT36525_1080_1920
		bool "NT36xxx_1080_1920"
		depends on I2C
		default n
		help
			Say Y here if you have a Novatek NT36xxx Panel
			to the host processor over I2C

			If unsure, say N.

endif
```
